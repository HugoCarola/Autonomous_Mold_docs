## software/Ethernet/Principal/ethernet/ComOvelayFim2/Kconfig/arch/Kconfig
```kconfig
# Load Zephyr Arch Kconfig descriptions.
osource "C:/Users/user/zephyr/arch/x86/Kconfig"
osource "C:/Users/user/zephyr/arch/xtensa/Kconfig"
osource "C:/Users/user/zephyr/arch/sparc/Kconfig"
osource "C:/Users/user/zephyr/arch/riscv/Kconfig"
osource "C:/Users/user/zephyr/arch/posix/Kconfig"
osource "C:/Users/user/zephyr/arch/nios2/Kconfig"
osource "C:/Users/user/zephyr/arch/mips/Kconfig"
osource "C:/Users/user/zephyr/arch/arm64/Kconfig"
osource "C:/Users/user/zephyr/arch/arm/Kconfig"
osource "C:/Users/user/zephyr/arch/arc/Kconfig"
```

## software/Ethernet/Principal/ethernet/ComOvelayFim2/Kconfig/boards/Kconfig.defconfig
```kconfig
# Load Zephyr board defconfig descriptions.
osource "C:/Users/user/zephyr/boards/nordic/nrf52833dk/Kconfig.defconfig"
```

## software/Ethernet/Principal/ethernet/ComOvelayFim2/Kconfig/boards/Kconfig.nrf52833dk
```kconfig
# Load board Kconfig descriptions.
osource "C:/Users/user/zephyr/boards/nordic/nrf52833dk/Kconfig.nrf52833dk"
```

## software/Ethernet/Principal/ethernet/ComOvelayFim2/Kconfig/boards/Kconfig.sysbuild
```kconfig
# Load Sysbuild board Kconfig descriptions.
osource "C:/Users/user/zephyr/boards/nordic/nrf52833dk/Kconfig.sysbuild"
```

## software/Ethernet/Principal/ethernet/comOverlay/Kconfig/soc/Kconfig
```kconfig
# Load Zephyr SoC Kconfig descriptions.
osource "C:/Users/user/zephyr/soc/xlnx/zynqmp/Kconfig"
osource "C:/Users/user/zephyr/soc/xlnx/zynq7000/Kconfig"
osource "C:/Users/user/zephyr/soc/xen/Kconfig"
osource "C:/Users/user/zephyr/soc/wch/ch32v00x/Kconfig"
osource "C:/Users/user/zephyr/soc/ti/simplelink/Kconfig"
osource "C:/Users/user/zephyr/soc/ti/lm3s6965/Kconfig"
osource "C:/Users/user/zephyr/soc/ti/k3/Kconfig"
osource "C:/Users/user/zephyr/soc/telink/tlsr/Kconfig"
osource "C:/Users/user/zephyr/soc/starfive/jh71xx/Kconfig"
osource "C:/Users/user/zephyr/soc/st/stm32/Kconfig"
osource "C:/Users/user/zephyr/soc/snps/qemu_arc/Kconfig"
osource "C:/Users/user/zephyr/soc/snps/nsim/arc_v/Kconfig"
osource "C:/Users/user/zephyr/soc/snps/nsim/arc_classic/Kconfig"
osource "C:/Users/user/zephyr/soc/snps/hsdk4xd/Kconfig"
osource "C:/Users/user/zephyr/soc/snps/hsdk/Kconfig"
osource "C:/Users/user/zephyr/soc/snps/emsk/Kconfig"
osource "C:/Users/user/zephyr/soc/snps/emsdp/Kconfig"
osource "C:/Users/user/zephyr/soc/snps/arc_iot/Kconfig"
osource "C:/Users/user/zephyr/soc/silabs/Kconfig"
osource "C:/Users/user/zephyr/soc/sifive/sifive_freedom/Kconfig"
osource "C:/Users/user/zephyr/soc/sensry/Kconfig"
osource "C:/Users/user/zephyr/soc/rockchip/Kconfig"
osource "C:/Users/user/zephyr/soc/renode/riscv_virtual/Kconfig"
osource "C:/Users/user/zephyr/soc/renode/cortex_r8_virtual/Kconfig"
osource "C:/Users/user/zephyr/soc/renesas/smartbond/Kconfig"
osource "C:/Users/user/zephyr/soc/renesas/rzt2m/Kconfig"
osource "C:/Users/user/zephyr/soc/renesas/rcar/Kconfig"
osource "C:/Users/user/zephyr/soc/renesas/ra/Kconfig"
osource "C:/Users/user/zephyr/soc/raspberrypi/Kconfig"
osource "C:/Users/user/zephyr/soc/quicklogic/eos_s3/Kconfig"
osource "C:/Users/user/zephyr/soc/qemu/virt_riscv/Kconfig"
osource "C:/Users/user/zephyr/soc/qemu/malta/Kconfig"
osource "C:/Users/user/zephyr/soc/openisa/rv32m1/Kconfig"
osource "C:/Users/user/zephyr/soc/nxp/s32/Kconfig"
osource "C:/Users/user/zephyr/soc/nxp/rw/Kconfig"
osource "C:/Users/user/zephyr/soc/nxp/mcx/Kconfig"
osource "C:/Users/user/zephyr/soc/nxp/lpc/Kconfig"
osource "C:/Users/user/zephyr/soc/nxp/layerscape/Kconfig"
osource "C:/Users/user/zephyr/soc/nxp/kinetis/Kconfig"
osource "C:/Users/user/zephyr/soc/nxp/imxrt/Kconfig"
osource "C:/Users/user/zephyr/soc/nxp/imx/Kconfig"
osource "C:/Users/user/zephyr/soc/nuvoton/numicro/Kconfig"
osource "C:/Users/user/zephyr/soc/nuvoton/numaker/Kconfig"
osource "C:/Users/user/zephyr/soc/nuvoton/npcx/Kconfig"
osource "C:/Users/user/zephyr/soc/nuvoton/npcm/Kconfig"
osource "C:/Users/user/zephyr/soc/nordic/Kconfig"
osource "C:/Users/user/zephyr/soc/neorv32/Kconfig"
osource "C:/Users/user/zephyr/soc/native/inf_clock/Kconfig"
osource "C:/Users/user/zephyr/soc/microchip/miv/Kconfig"
osource "C:/Users/user/zephyr/soc/microchip/mec/Kconfig"
osource "C:/Users/user/zephyr/soc/mediatek/mt8xxx/Kconfig"
osource "C:/Users/user/zephyr/soc/lowrisc/opentitan/Kconfig"
osource "C:/Users/user/zephyr/soc/litex/litex_vexriscv/Kconfig"
osource "C:/Users/user/zephyr/soc/ite/ec/Kconfig"
osource "C:/Users/user/zephyr/soc/intel/raptor_lake/Kconfig"
osource "C:/Users/user/zephyr/soc/intel/lakemont/Kconfig"
osource "C:/Users/user/zephyr/soc/intel/intel_socfpga_std/Kconfig"
osource "C:/Users/user/zephyr/soc/intel/intel_socfpga/Kconfig"
osource "C:/Users/user/zephyr/soc/intel/intel_niosv/Kconfig"
osource "C:/Users/user/zephyr/soc/intel/intel_ish/Kconfig"
osource "C:/Users/user/zephyr/soc/intel/intel_adsp/Kconfig"
osource "C:/Users/user/zephyr/soc/intel/elkhart_lake/Kconfig"
osource "C:/Users/user/zephyr/soc/intel/atom/Kconfig"
osource "C:/Users/user/zephyr/soc/intel/apollo_lake/Kconfig"
osource "C:/Users/user/zephyr/soc/intel/alder_lake/Kconfig"
osource "C:/Users/user/zephyr/soc/infineon/cat3/Kconfig"
osource "C:/Users/user/zephyr/soc/infineon/cat1b/Kconfig"
osource "C:/Users/user/zephyr/soc/infineon/cat1a/Kconfig"
osource "C:/Users/user/zephyr/soc/gd/gd32/Kconfig"
osource "C:/Users/user/zephyr/soc/gaisler/leon3/Kconfig"
osource "C:/Users/user/zephyr/soc/gaisler/gr716a/Kconfig"
osource "C:/Users/user/zephyr/soc/espressif/Kconfig"
osource "C:/Users/user/zephyr/soc/ene/kb1200/Kconfig"
osource "C:/Users/user/zephyr/soc/efinix/sapphire/Kconfig"
osource "C:/Users/user/zephyr/soc/cdns/xtensa_sample_controller/Kconfig"
osource "C:/Users/user/zephyr/soc/cdns/sample_controller32/Kconfig"
osource "C:/Users/user/zephyr/soc/cdns/dc233c/Kconfig"
osource "C:/Users/user/zephyr/soc/brcm/bcmvk/Kconfig"
osource "C:/Users/user/zephyr/soc/brcm/bcm2712/Kconfig"
osource "C:/Users/user/zephyr/soc/brcm/bcm2711/Kconfig"
osource "C:/Users/user/zephyr/soc/atmel/sam0/Kconfig"
osource "C:/Users/user/zephyr/soc/atmel/sam/Kconfig"
osource "C:/Users/user/zephyr/soc/aspeed/Kconfig"
osource "C:/Users/user/zephyr/soc/arm/Kconfig"
osource "C:/Users/user/zephyr/soc/arm/beetle/Kconfig"
osource "C:/Users/user/zephyr/soc/andestech/Kconfig"
osource "C:/Users/user/zephyr/soc/amd/acp_6_0/Kconfig"
osource "C:/Users/user/zephyr/soc/ambiq/Kconfig"
osource "C:/Users/user/zephyr/soc/altr/zephyr_nios2f/Kconfig"
osource "C:/Users/user/zephyr/soc/altr/qemu_nios2/Kconfig"
osource "C:/Users/user/zephyr/soc/adi/max32/Kconfig"
```

## software/Ethernet/Principal/ethernet/comOverlay/Kconfig/soc/Kconfig.soc
```kconfig
# Load SoC Kconfig descriptions.
osource "C:/Users/user/zephyr/soc/xlnx/zynqmp/Kconfig.soc"
osource "C:/Users/user/zephyr/soc/xlnx/zynq7000/Kconfig.soc"
osource "C:/Users/user/zephyr/soc/xen/Kconfig.soc"
osource "C:/Users/user/zephyr/soc/wch/ch32v00x/Kconfig.soc"
osource "C:/Users/user/zephyr/soc/ti/simplelink/Kconfig.soc"
osource "C:/Users/user/zephyr/soc/ti/lm3s6965/Kconfig.soc"
osource "C:/Users/user/zephyr/soc/ti/k3/Kconfig.soc"
osource "C:/Users/user/zephyr/soc/telink/tlsr/Kconfig.soc"
osource "C:/Users/user/zephyr/soc/starfive/jh71xx/Kconfig.soc"
osource "C:/Users/user/zephyr/soc/st/stm32/Kconfig.soc"
osource "C:/Users/user/zephyr/soc/snps/qemu_arc/Kconfig.soc"
osource "C:/Users/user/zephyr/soc/snps/nsim/arc_v/Kconfig.soc"
osource "C:/Users/user/zephyr/soc/snps/nsim/arc_classic/Kconfig.soc"
osource "C:/Users/user/zephyr/soc/snps/hsdk4xd/Kconfig.soc"
osource "C:/Users/user/zephyr/soc/snps/hsdk/Kconfig.soc"
osource "C:/Users/user/zephyr/soc/snps/emsk/Kconfig.soc"
osource "C:/Users/user/zephyr/soc/snps/emsdp/Kconfig.soc"
osource "C:/Users/user/zephyr/soc/snps/arc_iot/Kconfig.soc"
osource "C:/Users/user/zephyr/soc/silabs/Kconfig.soc"
osource "C:/Users/user/zephyr/soc/sifive/sifive_freedom/Kconfig.soc"
osource "C:/Users/user/zephyr/soc/sensry/Kconfig.soc"
osource "C:/Users/user/zephyr/soc/rockchip/Kconfig.soc"
osource "C:/Users/user/zephyr/soc/renode/riscv_virtual/Kconfig.soc"
osource "C:/Users/user/zephyr/soc/renode/cortex_r8_virtual/Kconfig.soc"
osource "C:/Users/user/zephyr/soc/renesas/smartbond/Kconfig.soc"
osource "C:/Users/user/zephyr/soc/renesas/rzt2m/Kconfig.soc"
osource "C:/Users/user/zephyr/soc/renesas/rcar/Kconfig.soc"
osource "C:/Users/user/zephyr/soc/renesas/ra/Kconfig.soc"
osource "C:/Users/user/zephyr/soc/raspberrypi/Kconfig.soc"
osource "C:/Users/user/zephyr/soc/quicklogic/eos_s3/Kconfig.soc"
osource "C:/Users/user/zephyr/soc/qemu/virt_riscv/Kconfig.soc"
osource "C:/Users/user/zephyr/soc/qemu/malta/Kconfig.soc"
osource "C:/Users/user/zephyr/soc/openisa/rv32m1/Kconfig.soc"
osource "C:/Users/user/zephyr/soc/nxp/s32/Kconfig.soc"
osource "C:/Users/user/zephyr/soc/nxp/rw/Kconfig.soc"
osource "C:/Users/user/zephyr/soc/nxp/mcx/Kconfig.soc"
osource "C:/Users/user/zephyr/soc/nxp/lpc/Kconfig.soc"
osource "C:/Users/user/zephyr/soc/nxp/layerscape/Kconfig.soc"
osource "C:/Users/user/zephyr/soc/nxp/kinetis/Kconfig.soc"
osource "C:/Users/user/zephyr/soc/nxp/imxrt/Kconfig.soc"
osource "C:/Users/user/zephyr/soc/nxp/imx/Kconfig.soc"
osource "C:/Users/user/zephyr/soc/nuvoton/numicro/Kconfig.soc"
osource "C:/Users/user/zephyr/soc/nuvoton/numaker/Kconfig.soc"
osource "C:/Users/user/zephyr/soc/nuvoton/npcx/Kconfig.soc"
osource "C:/Users/user/zephyr/soc/nuvoton/npcm/Kconfig.soc"
osource "C:/Users/user/zephyr/soc/nordic/Kconfig.soc"
osource "C:/Users/user/zephyr/soc/neorv32/Kconfig.soc"
osource "C:/Users/user/zephyr/soc/native/inf_clock/Kconfig.soc"
osource "C:/Users/user/zephyr/soc/microchip/miv/Kconfig.soc"
osource "C:/Users/user/zephyr/soc/microchip/mec/Kconfig.soc"
osource "C:/Users/user/zephyr/soc/mediatek/mt8xxx/Kconfig.soc"
osource "C:/Users/user/zephyr/soc/lowrisc/opentitan/Kconfig.soc"
osource "C:/Users/user/zephyr/soc/litex/litex_vexriscv/Kconfig.soc"
osource "C:/Users/user/zephyr/soc/ite/ec/Kconfig.soc"
osource "C:/Users/user/zephyr/soc/intel/raptor_lake/Kconfig.soc"
osource "C:/Users/user/zephyr/soc/intel/lakemont/Kconfig.soc"
osource "C:/Users/user/zephyr/soc/intel/intel_socfpga_std/Kconfig.soc"
osource "C:/Users/user/zephyr/soc/intel/intel_socfpga/Kconfig.soc"
osource "C:/Users/user/zephyr/soc/intel/intel_niosv/Kconfig.soc"
osource "C:/Users/user/zephyr/soc/intel/intel_ish/Kconfig.soc"
osource "C:/Users/user/zephyr/soc/intel/intel_adsp/Kconfig.soc"
osource "C:/Users/user/zephyr/soc/intel/elkhart_lake/Kconfig.soc"
osource "C:/Users/user/zephyr/soc/intel/atom/Kconfig.soc"
osource "C:/Users/user/zephyr/soc/intel/apollo_lake/Kconfig.soc"
osource "C:/Users/user/zephyr/soc/intel/alder_lake/Kconfig.soc"
osource "C:/Users/user/zephyr/soc/infineon/cat3/Kconfig.soc"
osource "C:/Users/user/zephyr/soc/infineon/cat1b/Kconfig.soc"
osource "C:/Users/user/zephyr/soc/infineon/cat1a/Kconfig.soc"
osource "C:/Users/user/zephyr/soc/gd/gd32/Kconfig.soc"
osource "C:/Users/user/zephyr/soc/gaisler/leon3/Kconfig.soc"
osource "C:/Users/user/zephyr/soc/gaisler/gr716a/Kconfig.soc"
osource "C:/Users/user/zephyr/soc/espressif/Kconfig.soc"
osource "C:/Users/user/zephyr/soc/ene/kb1200/Kconfig.soc"
osource "C:/Users/user/zephyr/soc/efinix/sapphire/Kconfig.soc"
osource "C:/Users/user/zephyr/soc/cdns/xtensa_sample_controller/Kconfig.soc"
osource "C:/Users/user/zephyr/soc/cdns/sample_controller32/Kconfig.soc"
osource "C:/Users/user/zephyr/soc/cdns/dc233c/Kconfig.soc"
osource "C:/Users/user/zephyr/soc/brcm/bcmvk/Kconfig.soc"
osource "C:/Users/user/zephyr/soc/brcm/bcm2712/Kconfig.soc"
osource "C:/Users/user/zephyr/soc/brcm/bcm2711/Kconfig.soc"
osource "C:/Users/user/zephyr/soc/atmel/sam0/Kconfig.soc"
osource "C:/Users/user/zephyr/soc/atmel/sam/Kconfig.soc"
osource "C:/Users/user/zephyr/soc/aspeed/Kconfig.soc"
osource "C:/Users/user/zephyr/soc/arm/Kconfig.soc"
osource "C:/Users/user/zephyr/soc/arm/beetle/Kconfig.soc"
osource "C:/Users/user/zephyr/soc/andestech/Kconfig.soc"
osource "C:/Users/user/zephyr/soc/amd/acp_6_0/Kconfig.soc"
osource "C:/Users/user/zephyr/soc/ambiq/Kconfig.soc"
osource "C:/Users/user/zephyr/soc/altr/zephyr_nios2f/Kconfig.soc"
osource "C:/Users/user/zephyr/soc/altr/qemu_nios2/Kconfig.soc"
osource "C:/Users/user/zephyr/soc/adi/max32/Kconfig.soc"
```
